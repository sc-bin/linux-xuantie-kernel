## Documentation/devicetree/bindings/pinctrl/canaan,k230-iomux.yaml
```yaml
# SPDX-License-Identifier: GPL-2.0-only
# Copyright (C) 2024 Canaan Kendryte Technology Co., Ltd.
%YAML 1.2
---
$id: http://devicetree.org/schemas/pinctrl/canaan,k230-iomux.yaml#
$schema: http://devicetree.org/meta-schemas/core.yaml#

title: Canaan Kendryte K230 IOMUX Controller

maintainers:
  - Your Name <your.email@example.com>

description:
  The K230 IOMUX controller provides control over pin functions, pull-up/pull-down
  resistance, drive strength, slew rate, and input/output enable for the K230 SoC.

  Reference: K230 Technical Reference Manual V0.3.1, Section 12.9.2
  Base Address: 0x91105000
  Each pin has a 32-bit register at offset pin*4

  For specific pin functions, see:
  - README-K230-IOMUX.md in drivers/pinctrl/canaan/
  - tttt.xlsx (source data for pin mappings)

properties:
  compatible:
    const: canaan,k230-iomux

  reg:
    description:
      Base address and size of the IOMUX controller register space.
      Register size is 0x100 (64 pins * 4 bytes each).
    maxItems: 1

  '#pinctrl-cells':
    description:
      Number of cells in a pinctrl property.
      For pin configuration nodes, use 1 cell (pin name string).
      For pinctrl phandles (e.g., in GPIO consumer properties), use 2 cells.
    const: 1

  clocks:
    description:
      Phandle to the APB clock source (iomux_pclk_gate).
    maxItems: 1

  clock-names:
    description:
      Name of the clock. Should be "apb".
    const: apb

required:
  - compatible
  - reg
  - '#pinctrl-cells'

additionalProperties: false

patternProperties:
  "-pins(-[0-9]+)?$":
    type: object
    description: Pin group configuration node

    properties:
      pins:
        description:
          List of pin names (strings).
          Valid pin names are: "io0", "io1", ..., "io63"
        minItems: 1
        items:
          - description: pin name string

    properties:
      function:
        description:
          Function to select for the pins.
          "gpio" = FUNC1 (GPIO mode)
          "alt1" = FUNC2 (Primary alternate)
          "alt2" = FUNC3 (Secondary alternate)
          "alt3" = FUNC4 (Tertiary alternate)
          "alt4" = FUNC5 (Quaternary alternate)
          "alt5" = FUNC6 (Test function 1)
          "alt6" = FUNC7 (Test function 2)
          "alt7" = FUNC8 (Test function 3)

    properties:
      bias-pull-up:
        description: Enable pull-up resistor
        type: boolean

      bias-pull-down:
        description: Enable pull-down resistor
        type: boolean

      bias-disable:
        description: Disable pull-up/pull-down
        type: boolean

      drive-strength:
        description: Drive strength (4-bit value 0-15)
        enum: [0, 1, 2, 3, 4, 5, 6, 7, 8, 9, 10, 11, 12, 13, 14, 15]

      slew-rate:
        description: Slew rate control (0=disable, 1=enable)
        enum: [0, 1]

      input-enable:
        description: Enable input buffer
        type: boolean

      output-enable:
        description: Enable output buffer
        type: boolean

      input-schmitt:
        description: Enable schmitt trigger
        type: boolean

examples:
  - |
    iomux: iomux@91105000 {
        compatible = "canaan,k230-iomux";
        reg = <0x0 0x91105000 0x0 0x100>;
        #pinctrl-cells = <1>;
        clocks = <&iomux_pclk_gate>;
        clock-names = "apb";
    };

    // UART0 pins - Function 2 (FUNC2 = UART0_TXD on pin 38, UART0_RXD on pin 39)
    uart0_pins: uart0-pins {
        pinmux {
            pins = "io38", "io39";
            function = "alt1";  // alt1 = FUNC2 = UART0_TXD/UART0_RXD
            bias-disable;
            drive-strength = <8>;
            slew-rate = <1>;  // Fast
        };
    };

    // SPI0 pins - Function 3 (example pins, check tttt.xlsx for actual pins)
    spi0_pins: spi0-pins {
        pinmux {
            pins = "io10", "io11", "io12", "io13";
            function = "alt2";  // alt2 = FUNC3
            bias-pull-up;
            drive-strength = <8>;
            slew-rate = <0>;  // Slow
        };
    };

    // I2C0 pins - Function 4 (example pins, check tttt.xlsx for actual pins)
    i2c0_pins: i2c0-pins {
        pinmux {
            pins = "io20", "io21";
            function = "alt3";  // alt3 = FUNC4
            bias-pull-up;
            drive-strength = <8>;
        };
    };

    // GPIO input with pull-up
    io_input: io-input-pins {
        pinmux {
            pins = "io30";
            function = "gpio";  // gpio = FUNC1
            bias-pull-up;
            input-enable;
        };
    };

    // GPIO output
    io_output: io-output-pins {
        pinmux {
            pins = "io40";
            function = "gpio";  // gpio = FUNC1
            drive-strength = <8>;
            output-enable;
        };
    };

    // LED output
    io_led: io-leds {
        compatible = "gpio-leds";
        led0 {
            gpios = <&iomux 50 0>;  // &iomux phandle with pin and flags (for GPIO consumer)
            default-state = "off";
        };
    };
```

## drivers/pinctrl/canaan/Kconfig
```kconfig
# SPDX-License-Identifier: GPL-2.0-only
#
# Canaan Kendryte K230 pinctrl drivers
#

config PINCTRL_K230_IOMUX
	bool "K230 IOMUX pinctrl driver"
	depends on RISCV && ARCH_CANAAN && OF
	select PINMUX
	select PINCONF
	select GENERIC_PINCONF
	select GPIOLIB
	help
	  Say Y here to enable the Canaan Kendryte K230 SoC IOMUX pinctrl driver.
	  This driver provides control over pin functions, pull-up/pull-down,
	  drive strength, and other pin configuration parameters for the K230 SoC.
```
