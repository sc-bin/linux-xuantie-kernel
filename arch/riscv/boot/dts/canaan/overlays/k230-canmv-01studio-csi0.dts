/dts-v1/;
/plugin/;

/ {
	fragment@0 {
		target-path = "/aliases";
		__overlay__ {
			i2c0 = "/soc/i2c@91405000";
		};
	};
	fragment@1 {
		target = <&i2c0>;
		__overlay__ {
			status="okay";
		};
	};
};
