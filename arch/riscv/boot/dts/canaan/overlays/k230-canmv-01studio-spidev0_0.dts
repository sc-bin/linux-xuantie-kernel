/dts-v1/;
/plugin/;

/ {
	fragment@0 {
		target = <&spi1>;
		__overlay__ {
            status = "okay";
			#address-cells = <1>;
			#size-cells = <0>;
			spidev0_0: spidev@0 {
				compatible = "rohm,dh2228fv";
				status = "okay";
				reg = <0>;
				spi-max-frequency = <100000000>;
			};
		};
	};
};
