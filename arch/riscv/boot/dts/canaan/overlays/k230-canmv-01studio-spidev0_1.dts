/dts-v1/;
/plugin/;

/ {
	fragment@0 {
		target = <&spi1>;
		__overlay__ {
            status = "okay";
			#address-cells = <1>;
			#size-cells = <0>;
			spidev0_1: spidev@1 {
				compatible = "rohm,dh2228fv";
				status = "okay";
				reg = <1>;
				spi-max-frequency = <100000000>;
			};
		};
	};
};
