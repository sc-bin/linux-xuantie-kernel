/dts-v1/;
/plugin/;
#include <dt-bindings/interrupt-controller/irq.h>
#include <dt-bindings/reset/canaan-k230-reset.h>
#include <dt-bindings/gpio/gpio.h>

/ {
	fragment@0 {
		target-path = "/aliases";
		__overlay__ {
			i2c0 = "/soc/i2c@91409000";
		};
	};
	fragment@1 {
		target = <&mipi0>;
		__overlay__ {
			id = <2>;
			reg = <0x0 0x9000a800 0x0 0x800>;
			interrupts = <121 IRQ_TYPE_LEVEL_HIGH>;
			resets = <&sysctl_reset K230_RESET_CSI2_REG_OFFSET K230_RESET_CSI2_TYPE
			K230_RESET_CSI2_DONE_BIT K230_RESET_CSI2_ASSERT_BIT>,
			<&sysctl_reset K230_RESET_M2_REG_OFFSET K230_RESET_M2_TYPE
			K230_RESET_M2_DONE_BIT K230_RESET_M2_ASSERT_BIT>;
			reset-gpios = <&gpio1_ports 30 GPIO_ACTIVE_HIGH>;

		};
	};
};
